/*
 * Copyright (C) 2012 Florian Vaussard, EPFL Mobots group
 *
 * This program is free software; you can redistribute it and/or modify
 * it under the terms of the GNU General Public License version 2 as
 * published by the Free Software Foundation.
 */
 
#include "omap3-vs-311x.dtsi"

&uart2 {
	pinctrl-names = "default";
	pinctrl-0 = <&uart2_pins>;
};