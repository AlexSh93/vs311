/*
 * Copyright (C) 2017 Matyushov Alexander, EPFL Mobots group
 *
 * This program is free software; you can redistribute it and/or modify
 * it under the terms of the GNU General Public License version 2 as
 * published by the Free Software Foundation.
 */

/*
 * Visom var-som manufactured by Visom LTD.
 */

/dts-v1/;

#include "omap3-vs-311.dtsi"

/ {
	model = "VAR-SOM-OM3x on VS311";
	compatible = "ti,omap36xx", "ti,omap3";
};

